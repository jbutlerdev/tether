// ssd1306.cpp — SSD1306 OLED controller implementation.
//
// On real hardware this drives the SSD1306 over I2C (the MVSR's
// Wire1 bus, GPIO 17/18, address 0x3C — see board_t3s3_mvsr.h).
// On the host build the I2C calls are stubbed and the framebuffer
// is the test fixture.
//
// The embedded 8×8 font is the public-domain font8x8_basic by
// Daniel Hepper (github.com/dhepper/font8x8, CC0 / public domain),
// trimmed to the ASCII printable range 0x20–0x7F. Each glyph is 8
// bytes, one per row, MSB = leftmost pixel.

#include "ssd1306.h"

#include <cstring>
#include <string>

#ifdef TETHER_M5_HOST_TEST
#include "freertos_shim.h"
#else
#include "driver/i2c.h"
#include "esp_log.h"
#endif

namespace tether::m5 {

namespace {
constexpr char kTag[] = "tether.oled";

// SSD1306 I2C control bytes.
constexpr uint8_t kCtrlCo = 0x80;   // control: continuation
constexpr uint8_t kCtrlCmd = 0x00;  // control: command stream
constexpr uint8_t kCtrlData = 0x40; // control: data stream

// SSD1306 fundamental commands.
constexpr uint8_t kCmdDisplayOff = 0xAE;
constexpr uint8_t kCmdDisplayOn = 0xAF;
constexpr uint8_t kCmdSetMuxRatio = 0xA8;
constexpr uint8_t kCmdSetDisplayOffset = 0xD3;
constexpr uint8_t kCmdSetDisplayStartLine = 0x40;
constexpr uint8_t kCmdSetSegmentRemap = 0xA1; // col 127 = SEG0
constexpr uint8_t kCmdSetComPins = 0xDA;
constexpr uint8_t kCmdSetComScanDir = 0xC8; // remapped mode
constexpr uint8_t kCmdSetContrast = 0x81;
constexpr uint8_t kCmdSetPrecharge = 0xD9;
constexpr uint8_t kCmdSetVcomDeselect = 0xDB;
constexpr uint8_t kCmdSetOscFreq = 0xD5;
constexpr uint8_t kCmdChargePump = 0x8D;
constexpr uint8_t kCmdMemoryMode = 0x20;
constexpr uint8_t kCmdSetColRange = 0x21;
constexpr uint8_t kCmdSetPageRange = 0x22;
constexpr uint8_t kCmdNormalDisplay = 0xA6;

// Minimal 8×8 ASCII font (public domain, font8x8_basic). Indexed by
// (ch - 0x20). Each row is one byte, MSB = leftmost pixel.
constexpr uint8_t kFont8x8[][8] = {
    {0x00, 0x00, 0x00, 0x00, 0x00, 0x00, 0x00, 0x00}, // space
    {0x18, 0x3C, 0x3C, 0x18, 0x18, 0x00, 0x18, 0x00}, // !
    {0x36, 0x36, 0x00, 0x00, 0x00, 0x00, 0x00, 0x00}, // "
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    {0x00, 0x00, 0x0C, 0x33, 0x1E, 0x00, 0x00, 0x00}, // ~
};

constexpr size_t kFontGlyphCount = sizeof(kFont8x8) / sizeof(kFont8x8[0]);

} // namespace

#ifndef TETHER_M5_HOST_TEST
// Send a command byte to the SSD1306 over I2C.
static esp_err_t SendCmd(i2c_port_t port, uint8_t addr, uint8_t cmd) {
  uint8_t buf[2] = {kCtrlCmd, cmd};
  return i2c_master_write_to_device(port, addr, buf, sizeof(buf),
                                    1000 / portTICK_PERIOD_MS);
}
#endif

bool Ssd1306::Init() {
#ifdef TETHER_M5_HOST_TEST
  Clear();
  inited_ = true;
  return true;
#else
  if (inited_) {
    return true;
  }
  // The MVSR's OLED is on I2C1 (board::kPinI2c1Scl/Sda). Configure
  // the bus master. The port index is 1 (I2C_NUM_1).
  const i2c_port_t port = I2C_NUM_1;
  i2c_config_t cfg = {};
  cfg.mode = I2C_MODE_MASTER;
  cfg.sda_io_num = board::kPinI2c1Sda;
  cfg.scl_io_num = board::kPinI2c1Scl;
  cfg.sda_pullup_en = GPIO_PULLUP_ENABLE;
  cfg.scl_pullup_en = GPIO_PULLUP_ENABLE;
  cfg.master.clk_speed = 400000; // 400 kHz
  esp_err_t err = i2c_param_config(port, &cfg);
  if (err != ESP_OK) {
    ESP_LOGE(kTag, "i2c_param_config: %d", err);
    return false;
  }
  err = i2c_driver_install(port, I2C_MODE_MASTER, 0, 0, 0);
  if (err != ESP_OK && err != ESP_ERR_INVALID_STATE) {
    ESP_LOGE(kTag, "i2c_driver_install: %d", err);
    return false;
  }
  const uint8_t addr = board::kSsd1306I2cAddr;
  auto ok = [&](uint8_t cmd) { return SendCmd(port, addr, cmd) == ESP_OK; };
  // Standard SSD1306 init sequence for a 128×64 panel.
  if (!ok(kCmdDisplayOff))
    return false;
  if (!ok(kCmdSetDisplayOffset))
    return false;
  if (!ok(0x00))
    return false;
  if (!ok(kCmdSetDisplayStartLine | 0x00))
    return false;
  if (!ok(kCmdSetSegmentRemap))
    return false;
  if (!ok(kCmdSetComScanDir))
    return false;
  if (!ok(kCmdSetComPins))
    return false;
  if (!ok(0x12))
    return false; // COM pins hardware config for 128×64
  if (!ok(kCmdSetContrast))
    return false;
  if (!ok(0x7F))
    return false;
  if (!ok(kCmdNormalDisplay))
    return false;
  if (!ok(kCmdMemoryMode))
    return false;
  if (!ok(0x00))
    return false; // horizontal addressing
  if (!ok(kCmdSetOscFreq))
    return false;
  if (!ok(0x80))
    return false;
  if (!ok(kCmdChargePump))
    return false;
  if (!ok(0x14))
    return false; // enable charge pump
  if (!ok(kCmdDisplayOn))
    return false;
  Clear();
  inited_ = true;
  return Flush();
#endif
}

void Ssd1306::Clear() { std::memset(buf_, 0, sizeof(buf_)); }

bool Ssd1306::Flush() {
#ifdef TETHER_M5_HOST_TEST
  return inited_;
#else
  if (!inited_) {
    return false;
  }
  const i2c_port_t port = I2C_NUM_1;
  const uint8_t addr = board::kSsd1306I2cAddr;
  // Set the column and page window to the full panel.
  if (SendCmd(port, addr, kCmdSetColRange) != ESP_OK)
    return false;
  if (SendCmd(port, addr, 0x00) != ESP_OK)
    return false;
  if (SendCmd(port, addr, kOledWidth - 1) != ESP_OK)
    return false;
  if (SendCmd(port, addr, kCmdSetPageRange) != ESP_OK)
    return false;
  if (SendCmd(port, addr, 0x00) != ESP_OK)
    return false;
  if (SendCmd(port, addr, (kOledHeight / 8) - 1) != ESP_OK)
    return false;
  // Stream the framebuffer in 16-byte I2C payloads (control byte +
  // data). The SSD1306 auto-advances through the column/page window.
  for (size_t off = 0; off < kOledBufSize; off += 16) {
    uint8_t pkt[1 + 16] = {kCtrlData};
    size_t n = std::min(size_t(16), kOledBufSize - off);
    std::memcpy(pkt + 1, buf_ + off, n);
    esp_err_t err = i2c_master_write_to_device(port, addr, pkt, 1 + n,
                                               1000 / portTICK_PERIOD_MS);
    if (err != ESP_OK) {
      ESP_LOGE(kTag, "i2c write fb @%zu: %d", off, err);
      return false;
    }
  }
  return true;
#endif
}

bool Ssd1306::DrawText(int col, int row, const std::string &text) {
  if (col < 0 || row < 0) {
    return false;
  }
  const int max_cols = static_cast<int>(kOledWidth / 8);
  const int max_rows = static_cast<int>(kOledHeight / 8);
  if (row >= max_rows) {
    return false;
  }
  int c = col;
  for (char ch : text) {
    if (c >= max_cols) {
      break;
    }
    uint8_t idx = static_cast<uint8_t>(ch);
    if (idx < 0x20 || idx > 0x7E) {
      idx = 0x20; // unmapped → space
    }
    const uint8_t *glyph = kFont8x8[idx - 0x20];
    // Each glyph row is one byte; the OLED buffer is page-addressed
    // (8 vertical pixels per byte). row*8 is the page base.
    const size_t base =
        static_cast<size_t>(row) * kOledStride + static_cast<size_t>(c) * 1;
    for (int y = 0; y < 8; y++) {
      size_t p = base + static_cast<size_t>(y) * kOledStride;
      if (p >= kOledBufSize) {
        break;
      }
      // Glyph row byte: bit 0 = top pixel. OLED page byte: bit 0 =
      // top pixel. So they line up directly.
      buf_[p] = glyph[y];
    }
    c++;
  }
  return true;
}

void Ssd1306::RenderBootScreen() {
  Clear();
  DrawText(0, 0, "TETHER");
  DrawText(0, 1, board::kBoardName);
  DrawText(0, 3, "READY");
  // The full screen set (idle / recording / queued / TX / TTS /
  // settings / low-battery) at 128×64 is a follow-up that mirrors
  // the M5's epd/screens.cpp; this boot screen is the "it works"
  // confirmation for the MVSR variant.
}

std::string Ssd1306::DumpBufferForTest() const {
  return std::string(reinterpret_cast<const char *>(buf_), kOledBufSize);
}

} // namespace tether::m5
