## firmware/m5/components/board/Kconfig
```kconfig
# board/Kconfig — Tether board variant selection.
#
# ESP-IDF auto-discovers this Kconfig and merges it into menuconfig.
# The choice selects exactly one hardware variant; the selected
# CONFIG_TETHER_BOARD_* define is consumed by board/include/board.h
# to include the right pin map. See docs/VARIANTS.md.

menu "Tether board variant"
    choice TETHER_BOARD
        prompt "Target board"
        default TETHER_BOARD_M5
        help
            Select the hardware variant the firmware is built for.
            Each variant has its own pin map in board/include/board_<name>.h.
            See docs/VARIANTS.md for the wiring and hardware-mod requirements.

        config TETHER_BOARD_M5
            bool "ThinkNode M5 (ELECROW)"
            help
                The ELECROW ThinkNode M5 (ESP32-S3 + SX1262 + 1.54" EPD).
                Requires the GPS-removal + buzzer-removal hardware mods
                (see docs/HARDWARE-MODS.md) before the audio path works.

        config TETHER_BOARD_T3S3_MVSR
            bool "LilyGO T3-S3 MVSR"
            help
                The LilyGO T3-S3 V1.2 + MVSR backplate (ESP32-S3 + SX1262
                + 0.96" SSD1306 OLED). No hardware mod required. Needs an
                external PTT button wired to GPIO 4 (see docs/VARIANTS.md).
    endchoice
endmenu
```

## firmware/m5/main/Kconfig.projbuild
```kconfig
menu "Tether"
    # Suppress the I2S legacy driver deprecation warning. The new
    # driver (driver/i2s_std.h) is preferred for new code, but the
    # legacy APIs are still supported and adequate for the M5
    # (which uses a single INMP441 / MAX98357A pair).
    config I2S_SUPPRESS_DEPRECATE_WARN
        bool "Suppress I2S legacy driver deprecation warning"
        default y
endmenu
```

## firmware/m5/sdkconfig.defaults
```kconfig
# ESP32-S3 defaults for the Tether M5 firmware.
# See plan.md §1.1.
CONFIG_ESP32S3_DEFAULT_CPU_FREQ_240=y
CONFIG_SPIRAM=y
CONFIG_SPIRAM_MODE_OCT=y
CONFIG_FREERTOS_HZ=1000
CONFIG_ESP_TASK_WDT_EN=y
```

## firmware/m5/sdkconfig.defaults.t3s3_mvsr
```kconfig
# sdkconfig.defaults.t3s3_mvsr — overrides for the LilyGO T3-S3 MVSR.
#
# Build with: idf.py set-target esp32s3 && idf.py \
#   -DSDKCONFIG_DEFAULTS=sdkconfig.defaults;sdkconfig.defaults.t3s3_mvsr \
#   build
#
# (CI passes SDKCONFIG_DEFAULTS to select this file; see
# .github/workflows/firmware-build.yml's m5-esp-idf-build job.)
#
# The T3-S3 module uses QUAD (QSPI) flash + PSRAM, not octal. The
# M5's sdkconfig.defaults sets CONFIG_SPIRAM_MODE_OCT=y; the MVSR
# must use QUAD or GPIO 33–37 (used for LoRa DIO1/BUSY, mic EN, LED)
# crash the flash/PSRAM controller. See board_t3s3_mvsr.h.

# Select the MVSR board variant (consumed by board/include/board.h).
CONFIG_TETHER_BOARD_T3S3_MVSR=y

# Quad (QSPI) PSRAM — the T3-S3 module is QSPI, not OPI.
CONFIG_SPIRAM_MODE_QUAD=y
# CONFIG_SPIRAM_MODE_OCT is not set

# The T3-S3 module is ESP32-S3-WROOM-1 with 8 MB flash + 8 MB PSRAM
# (matches the M5's N16R8, but QSPI variant). Keep the rest of the
# M5 defaults (CPU 240, SPIRAM, C++ exceptions, I2S legacy warn).
```
